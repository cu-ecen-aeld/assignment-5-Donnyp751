## base_external/Config.in
```kconfig
source "$BR2_EXTERNAL_aesd_assignment_PATH/package/aesd-assignments/Config.in"
source "$BR2_EXTERNAL_aesd_assignment_PATH/package/ldd/Config.in"
source "$BR2_EXTERNAL_aesd_assignment_PATH/package/assignment-3-later/Config.in"
```

## base_external/package/assignment-3-later/Config.in
```kconfig
config BR2_PACKAGE_ASSIGNMENT_3_LATER
	bool "assignment-3-later"
	depends on BR2_LINUX_KERNEL
	help
	  AESD char driver kernel module and aesdsocket server from
	  assignments-3-and-later repository. Includes init scripts
	  to load the kernel module and start the socket server on boot.
```

## base_external/package/ldd/Config.in
```kconfig
config BR2_PACKAGE_LDD
	bool "ldd"
	depends on BR2_LINUX_KERNEL
	help
	  Misc programs and kernel modules from the LDD3 examples repository.
	  Builds and installs userspace programs and out-of-tree kernel modules.
```
